## mock-sensor-recipe/conf/layer.conf
```bitbake
BBPATH .= ":${LAYERDIR}"

BBFILES += "${LAYERDIR}/recipes-*/*/*.bb \
            ${LAYERDIR}/recipes-*/*/*.bbappend"

BBFILE_COLLECTIONS += "workspace"
BBFILE_PATTERN_workspace = "^${LAYERDIR}/"
BBFILE_PRIORITY_workspace = "6"
LAYERSERIES_COMPAT_workspace = "nanbield scarthgap styhead walnascar wrynose"
```
